/////////////////////////////////////////////////////////////////////////
////                Programa para tocuh y GLCD                       ////
//// -c0 touch -c1 tocuh An0- canal analogico 1  y An1 otra          ////
//// -c3 prendido apagado de ampli                                   ////
//// -c4 volumen mas                                                 ////
//// -c5 volumen menos                                               ////
//// -c6 transmisor rs232 para luz                                   ////
//// 13-Osc                                                          ////
//// 14-Osc                                                          ////
////     A2 A4 A5 salida para rf con E0                              ////
////     0000 nada       0011 late2   0110prender1001vol+   1100       1111      ///
////     0001 late1      0100 presno  1010apgar  1101                ////
////     0010 centro     0101 pressi  1011vol-   1110                ////
/////////////////////////////////////////////////////////////////////////


/////////////////////////////////////////////////////////////////////////
//Configuracion de includes                                             /
/////////////////////////////////////////////////////////////////////////

#include <16f877a.h>
#device ADC=10;
#include <stdio.h>


#include <STRING.h>
#use delay (clock=4000000)
#use rs232 (baud=2400,parity=N,xmit=PIN_C6,rcv=PIN_C7,bits=8)
#include <C:\Users\Nico\Documents\carpetas\Programa para glcd\GLCDNICO.TXT>
#fuses XT,NOWDT,PUT
#byte porta=0x05
#byte portd=0x08
#byte trisa=0x85
#byte trisd=0x88
/////////////////////////////////////////////////////////////////////////
// Pantalla de inicio                                                   /
/////////////////////////////////////////////////////////////////////////
const unsigned char nico [512] = {
0xff, 0xff, 0xff, 0xff, 0x00, 0x00, 0x00, 0x00, 0x00, 0x00, 0x00, 0x00, 0x00, 0x00, 0x00, 0x00,
0x00, 0x00, 0x00, 0x00, 0x00, 0x00, 0x00, 0x00, 0x00, 0x00, 0x00, 0x00, 0x00, 0x00, 0x00, 0x00,
0x00, 0x00, 0x00, 0x00, 0x00, 0x00, 0x00, 0x00, 0x00, 0x00, 0x00, 0x00, 0x00, 0x00, 0x00, 0x00,
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0x01, 0x01, 0x01, 0x01, 0x01, 0x01, 0x01, 0x00, 0x00, 0x01, 0x01, 0x01, 0x00, 0x00, 0x01, 0x01
};
const unsigned char mitad [512] = {
0x00, 0x00, 0x00, 0x00, 0x00, 0x00, 0x00, 0x00, 0x00, 0x00, 0x00, 0x00, 0x00, 0x00, 0x00, 0x00,
0x00, 0x00, 0x00, 0x00, 0x00, 0x00, 0x00, 0x00, 0x00, 0x00, 0x00, 0x00, 0x00, 0x00, 0x00, 0x00,
0x00, 0x00, 0x00, 0x00, 0x00, 0x00, 0x00, 0x00, 0x00, 0x00, 0x00, 0x00, 0x00, 0x00, 0x00, 0x00,
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0x01, 0x01, 0x01, 0x01, 0x00, 0x00, 0x00, 0x00, 0x00, 0x00, 0x00, 0x00, 0x00, 0x00, 0x00, 0x00
};

/////////////////////////////////////////////////////////////////////////
//Declaracion de funciones y variables                                 /
/////////////////////////////////////////////////////////////////////////
char titulo[]="Control Remoto";
char luces[]="Luces";
char audio[]="Audio";
char cortina[]="Cortinas";
char ampli[]="Amplificador";
char prende[]="prender";
char apaga[]="apagar";
char menu1[]="Menu";
char volumen[]="Volumen";
char PUNTA[]="Punta";
char centro[]="Centro";
char todos[]="Todos";
char non[]= "NO";
char sis[]= "SI";
void pulsaluz();
void pulsaaudio();
void pulsacortina();
void menu();
void solto();
void posicion();
int menuluz();
int menuaudio();
int menucortinas();

char c="";
int16 getx();
int16 gety();
char x;
char y;
int16 x_coord;
int16 y_coord;
int16 x_coord128;
int16 y_coord64;
int8 selector=0;
int16 i=0;
int a=0;
char mensaje;
/////////////////////////////////////////////////////////////////////////
// Programa principal                                                   /
/////////////////////////////////////////////////////////////////////////
void main(){
porta=0;
SET_TRIS_A(0x0b);
SET_TRIS_B(0x00);
SET_TRIS_C(0x80);
SET_TRIS_D(0x00);
SET_TRIS_E(0x00);

output_high(PIN_B7);
setup_adc_ports(AN0_AN1_AN3);// PUERTO A1 COMO ANAL
setup_adc(ADC_CLOCK_INTERNAL); // configuro ADC
glcd_init(on);
glcd_fillScreen(OFF);
DELAY_MS(1000);
a=0;
incrementar(a);
i=0;
while(i<512){
glcd_writeByte(GLCD_CS1,nico[i]);
i++;
if (i==64 || i==128 || i==192 || i==256 || i==320 || i==384 || i==448 || i==512){
a=a+1;
incrementar (a);
}
}
a=0;
incrementar(a);
i=0;
while(i<512){
glcd_writeByte(GLCD_CS2,mitad[i]);
i++;
if (i==64 || i==128 || i==192 || i==256 || i==320 || i==384 || i==448 || i==512){
a=a+1;
incrementar2 (a);
}
}
delay_ms (2000);
glcd_fillScreen(OFF);
selector=0;
menu();
while(true){

x=getx();
y=gety();
if ( x>=11 && x<=60 && y>=20 && y<=30){
   pulsaluz();
   menuluz();
   delay_ms(1000);
   x=0;
   y=0;
}

if ( x>=66 && x<=115 && y>=20 && y<=30){
   pulsaaudio();
   menuaudio();
   delay_ms(1000);
   x=0;
   y=0;}
//presiona audio
if ( x>=11 && x<=40 && y>=45 && y<=56){
   pulsacortina();
   menucortinas();
   delay_ms(1000);
   x=0;
   y=0;}
}//presiona cortinas

}
/////////////////////////////////////////////////////////////////////////
//Funcion para declarar lla pulsada de luz                              /
/////////////////////////////////////////////////////////////////////////
void pulsaluz(){
   glcd_rect(11, 23,60 ,35 , YES , ON );
   glcd_text57(22,25,luces,1,off) ;
// HACER QUE SUELTE LO PULSADO
   delay_ms (1000);
   glcd_rect(12, 24,59 ,34 , yes , off );
   glcd_text57(22,25,luces,1,on) ;
}
/////////////////////////////////////////////////////////////////////////
//Funcion de pulsacion de audio                                         /
/////////////////////////////////////////////////////////////////////////
void pulsaaudio(){
   glcd_rect(66, 22,115 ,35 , yes , ON );//3 Auido
   glcd_text57(76,25,audio,1,off) ;
// HACER QUE SUELTE LO PULSADO
   delay_ms (1000);
   glcd_rect(67, 23,114 ,34 , yes , off );//3 Auido
   glcd_text57(76,25,audio,1,yes) ;
}
/////////////////////////////////////////////////////////////////////////
//funcion para pulsar cortina                                           /
/////////////////////////////////////////////////////////////////////////
void pulsacortina(){
   glcd_rect(11, 41,60 ,56 , YES, ON );
   glcd_text57(13,44,cortina,1,off) ;
// HACER QUE SUELTE LO PULSADO
   delay_ms (1000);
   glcd_rect(12, 42,59 ,55 , yes, off);
   glcd_text57(13,44,cortina,1,on) ;
}
/////////////////////////////////////////////////////////////////////////
//Funcion de pantalla de menu                                           /
/////////////////////////////////////////////////////////////////////////
void menu(){
   glcd_fillScreen(OFF);
   glcd_text57(15,5,Titulo,1,on) ;
   glcd_rect(0, 0, 127, 63, NO , ON );
   glcd_rect(8, 19, 118, 60, NO , ON );
   glcd_rect(11, 23,60 ,35 , NO , ON );//1 LUZ
   glcd_rect(11, 41,60 ,56 , NO , ON );//2 CORTINA
   glcd_rect(66, 22,115 ,35 , NO , ON );//3 Auido
   glcd_rect(66,42 ,115 ,56 , NO , ON );//4 PENDIENTE
   glcd_line(8,38,118,38,ON);
   glcd_line(63,19,63,60,on);
   glcd_text57(22,25,luces,1,on) ;
   glcd_text57(13,44,cortina,1,on) ;
   glcd_text57(76,25,audio,1,on) ;
}
/////////////////////////////////////////////////////////////////////////
//Funcion para chequear el touch                                        /
/////////////////////////////////////////////////////////////////////////
int16 getx(){
   output_high(pin_c0);
   output_low(pin_c1);
   set_adc_channel(0);
   delay_ms (5);
   x_coord= read_adc(); // leer analogico 0
   if(x_coord>= 512){
      x_coord=x_coord - 512;
      x_coord128=(x_coord * 128)/1024;
      x_coord128=x_coord128 + 64;
   }else{
         x_coord128=((x_coord * 128 ) /1024);}
    return x_coord128;
}
/////////////////////////////////////////////////////////////////////////
//Funcion para chequear touch                                           /
/////////////////////////////////////////////////////////////////////////
int16 gety(){
   output_low(pin_c0);
   output_high(pin_c1);
   set_adc_channel(1);
   delay_ms (5);
   y_coord=read_adc(); // leer el analogico 1
   y_coord64=64-((y_coord * 64) /1024);
   return y_coord64;

}
/////////////////////////////////////////////////////////////////////////
//Funcion para mostrar el menu de la luz                                /
/////////////////////////////////////////////////////////////////////////
int menuluz(){
   glcd_fillScreen(OFF);
   glcd_rect(0, 0, 127, 63, NO , ON );//cuadro exterior
   //glcd_rect(22, 20, 105, 35, NO , ON );//cuadro prender apagar
   //glcd_line(66,20,66,35,on);//linea titulo prende apaga
   glcd_text57(8,21,PUNTA,1,on);//texto punta
   glcd_text57(48,21,centro,1,on);//texto centro
   glcd_text57(92,21,PUNTA,1,on);//texto punta
   glcd_circle(21,11,8,NO,ON);// circulo lateral
   glcd_circle(63,11,8,NO,ON);//circulo central
   glcd_circle(105,11,8,NO,ON);//circulo lateral
   glcd_text57(36,44,todos,1,on);//texto  todos
   glcd_rect(84, 42, 94, 53, NO , ON );//cuadro no
   glcd_rect(97,42, 107, 53, NO , ON );//cuadro si
   glcd_text57(70,44,sis,1,on);//texto  no
   glcd_text57(112,44,non,1,on);//texto  si
   glcd_text57(7,49,menu1,1,on);//texto menu
   glcd_rect(4, 45, 32, 58, NO , ON );//cuadro menu

   while(true){
      x=getx();
      y=gety();
   if ( x>=13 && x<=25 && y>=6 && y<=15){
     output_high(pin_a2);
     output_low(pin_a4);
     output_low(pin_a5);
     output_low(pin_e0);
     
      printf("1");
      x=0;
      y=0;
      delay_ms (1000);
      output_low(pin_a2);
     output_low(pin_a4);
     output_low(pin_a5);
     output_low(pin_e0);}//presiona lateral 1
      
   if ( x>=55 && x<=71 && y>=6 && y<=15){
            output_low(pin_a2);
     output_high(pin_a4);
     output_low(pin_a5);
     output_low(pin_e0);
      printf("2");
      x=0;
      y=0;
      delay_ms (1000);
            output_low(pin_a2);
     output_low(pin_a4);
     output_low(pin_a5);
     output_low(pin_e0);}//presiona centro

   if ( x>=87 && x<=113 && y>=6 && y<=15){
      output_high(pin_a2);
     output_high(pin_a4);
     output_low(pin_a5);
     output_low(pin_e0);      
      printf("3");
      delay_ms (1000);
      x=0;
      y=0;
      delay_ms (1000);
      output_low(pin_a2);
     output_low(pin_a4);
     output_low(pin_a5);
     output_low(pin_e0);      }//presiona lateral 2
   if ( x>=97 && x<=107 && y>=42 && y<=53){
      output_low(pin_a2);
     output_low(pin_a4);
     output_high(pin_a5);
     output_low(pin_e0);     
     printf("4");
      x=0;
      y=0;
      delay_ms (1000);
            output_low(pin_a2);
     output_low(pin_a4);
     output_low(pin_a5);
     output_low(pin_e0);
      }//presiona no
   if ( x>=66 && x<=80 && y>=42 && y<=53){
            output_high(pin_a2);
     output_low(pin_a4);
     output_high(pin_a5);
     output_low(pin_e0);
      printf("5");
      x=0;
      y=0;
      delay_ms (1000);
            output_low(pin_a2);
     output_low(pin_a4);
     output_low(pin_a5);
     output_low(pin_e0);}//presiona si
   if ( x>=4 && x<=20 && y>=50 && y<=58){
      menu();
      x=0;
      y=0;
   return 1;}
}//presiona menu
}
/////////////////////////////////////////////////////////////////////////
// Funcion para mostrar el menu audio                                   /
/////////////////////////////////////////////////////////////////////////
int menuaudio(){
   glcd_fillScreen(OFF);
   glcd_rect(0, 0, 127, 63, NO , ON );//cuadro exterior
   glcd_rect(22, 20, 105, 35, NO , ON );//cuadro prender apagar
   glcd_line(66,20,66,35,on);//linea titulo prende apaga
   glcd_line(29,15,98,15,on);//linea titulo ampli
   glcd_rect(4, 45, 32, 58, NO , ON );//cuadro menu
   glcd_rect(89, 42, 101, 53, NO , ON );//cuadro volumen menos
   glcd_rect(107,42, 119, 53, NO , ON );//cuadro volmen mas
   glcd_text57(29,6,ampli,1,on);//texto ampli
   glcd_text57(24,24,prende,1,on);//texto prende
   glcd_text57(68,24,apaga,1,on);//texto apaga
   glcd_text57(7,49,menu1,1,on);//texto menu
   glcd_text57(41,44,volumen,1,on);//texto volumen
   glcd_line(92,48,97,48,on);//linea -
   glcd_line(110,48,116,48,on);//linea +
   glcd_line(113,45,113,51,on);//linea +
   while(true){
    x=getx();
    y=gety();
   if (x>=20 && x<=40 && y>=18 && y<=30){
            output_low(pin_a2);
     output_high(pin_a4);
     output_high(pin_a5);
     output_low(pin_e0);
      printf("6");
      x=0;
      y=0;  
      delay_ms (1000);
            output_low(pin_a2);
     output_low(pin_a4);
     output_low(pin_a5);
     output_low(pin_e0);
}//Cuadro prender

   if (x>=70 && x<=90 && y>=18 && y<=30){
            output_high(pin_a2);
     output_high(pin_a4);
     output_high(pin_a5);
     output_low(pin_e0);
      printf("7");
      x=0;
      y=0;
      delay_ms (1000);
            output_low(pin_a2);
     output_low(pin_a4);
     output_low(pin_a5);
     output_low(pin_e0);
}//cuadro apagar

   if (x>=66 && x<=85 && y>=42 && y<=53){
            output_low(pin_a2);
     output_low(pin_a4);
     output_low(pin_a5);
     output_high(pin_e0);
      printf("8");
      x=0;
      y=0;
      delay_ms (1000);
            output_low(pin_a2);
     output_low(pin_a4);
     output_low(pin_a5);
     output_low(pin_e0);
}// cuadro volumen menos
   if (x>=97 && x<=107 && y>=42 && y<=53){
            output_high(pin_a2);
     output_low(pin_a4);
     output_low(pin_a5);
     output_high(pin_e0);
      printf("9");
      x=0;
      y=0;
      delay_ms (1000);
            output_low(pin_a2);
     output_low(pin_a4);
     output_low(pin_a5);
     output_low(pin_e0);
}// cuadro volumen mas
   if (x>=4 && x<=15 && y>=50 && y<=58){
      menu();
      return 1;
}
}//presiona menu
}
/////////////////////////////////////////////////////////////////////////
// Funcion par mostrar el menu de cotina                                /
/////////////////////////////////////////////////////////////////////////
int menucortinas()
   {glcd_fillScreen(OFF);
    glcd_rect(0, 0, 127, 63, NO , ON );//cuadro exterior
    glcd_text57(7,49,menu1,1,on);//texto menu
    glcd_rect(4, 45, 32, 58, NO , ON );//cuadro menu

    while(true){
      x=getx();
      y=gety();
   if ( x>=4 && x<=20 && y>=51 && y<=58){
      menu();
   return 1;
}//presiona menu
}}
/////////////////////////////////////////////////////////////////////////
//Funcion para ver si solto el touch                                    /
/////////////////////////////////////////////////////////////////////////
void solto(){
   i=0;
   while(i==1)
      {x=getx();
      y=gety();
   if (x>1 && x<125 && y>2 && y<62){
      i=0;}
    else{i=1;}
}
}

